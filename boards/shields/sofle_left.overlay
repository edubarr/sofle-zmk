&i2c1 {
    status = "okay";
    ssd1306: ssd1306@3c {
        compatible = "solomon,ssd1306fb";
        reg = <0x3c>;
        label = "SSD1306";
        width = <128>;
        height = <32>;
        segment-offset = <0>;
        page-offset = <0>;
        // reset-gpios = <&gpio0 10 GPIO_ACTIVE_LOW>; // Uncomment and set if you use a reset pin
    };
};
